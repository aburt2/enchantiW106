## firmware/examples/simple_osc/boards/nxp/enchantiW106/board.yml
```yaml
board:
  name: enchantiW106
  full_name: enchantiW106
  vendor: nxp
  socs:
    - name: rw612
```

## firmware/examples/simple_osc/boards/nxp/enchantiW106/enchantiW106_defconfig
```kconfig
#
# Copyright 2022 NXP
#
# SPDX-License-Identifier: Apache-2.0
#

CONFIG_CONSOLE=y
CONFIG_UART_CONSOLE=y
CONFIG_SERIAL=y
CONFIG_UART_INTERRUPT_DRIVEN=y
CONFIG_GPIO=y
CONFIG_SPI=y
CONFIG_I2C=y
CONFIG_SENSING=y
CONFIG_MAX17262=y
CONFIG_MMC56X3=y
CONFIG_ICM42670=y
CONFIG_ARM_MPU=y
CONFIG_HW_STACK_PROTECTION=y
CONFIG_TRUSTED_EXECUTION_SECURE=y
```
