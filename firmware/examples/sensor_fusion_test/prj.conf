## CMakeLists.txt
```
# SPDX-License-Identifier: Apache-2.0

cmake_minimum_required(VERSION 3.20.0)

# Add boards directory
list(APPEND BOARD_ROOT ${CMAKE_CURRENT_SOURCE_DIR}/..)

# add build fladg
add_definitions(-DSENSOR_FUSION_FLOATS)

find_package(Zephyr REQUIRED HINTS $ENV{ZEPHYR_BASE})
project(simple_osc)

# Compile with hardware float
zephyr_cc_option(-mfloat-abi=hard)

# Set library path for dependents
set(LIBDEPS_PATH "libdeps")

# Create variables for library dependents
# Sensor Fusion
set(SENSOR_FUSION_SOURCE_PATH ${LIBDEPS_PATH}/IMU_Sensor_Fusion)
set(SENSOR_FUSION_INCLUDE_PATH ${LIBDEPS_PATH}/IMU_Sensor_Fusion)
# Puara Gestures
# set(PUARA_GESTURES_ROOT ${LIBDEPS_PATH}/puara-gestures)
# set(PUARA_GESTURES_SOURCE_PATH ${PUARA_GESTURES_ROOT}/src)
# set(PUARA_GESTURES_INCLUDE_PATH ${PUARA_GESTURES_ROOT}/include)

# Target repositories in libdeps sources
FILE(GLOB sensor_fusion_sources
    ${SENSOR_FUSION_SOURCE_PATH}/*.c*
)

# FILE(GLOB puara_gesture_sources
#     ${PUARA_GESTURES_SOURCE_PATH}/*.c*
# )

# Target app sources
FILE(GLOB app_sources src/*.c*)

target_sources(app PRIVATE 
    ${sensor_fusion_sources}
    # ${puara_gesture_sources}
    ${app_sources}
)

# add_executable(crc32 crc32.c)
target_include_directories(app PRIVATE 
    ${SENSOR_FUSION_INCLUDE_PATH}
    # ${PUARA_GESTURES_INCLUDE_PATH}
)
```

## prj.conf
```kconfig
# Project specific conf
CONFIG_CPP=y
CONFIG_GLIBCXX_LIBCPP=y
CONFIG_STD_CPP20=y
CONFIG_CPP_EXCEPTIONS=y

# FPU settings
CONFIG_FPU=y
CONFIG_FPU_SHARING=y

# Power management settings
CONFIG_PM=y
CONFIG_EARLY_CONSOLE=y
CONFIG_TEST_RANDOM_GENERATOR=y
CONFIG_POSIX_API=y
CONFIG_THREAD_RUNTIME_STATS=y
CONFIG_THREAD_RUNTIME_STATS_USE_TIMING_FUNCTIONS=y
CONFIG_MAIN_STACK_SIZE=5200
```

## boards/enchantiW106.conf
```kconfig
#
# C Library
#
CONFIG_REQUIRES_FULL_LIBC=y
CONFIG_CBPRINTF_FP_SUPPORT=y

# # Setup timer with 1us resolution
# CONFIG_SYS_CLOCK_TICKS_PER_SEC=1000000

# os
CONFIG_THREAD_CUSTOM_DATA=y
CONFIG_EVENTS=y
CONFIG_SYS_HEAP_AUTO=y
CONFIG_HEAP_MEM_POOL_SIZE=122880
CONFIG_SCHED_MULTIQ=y
CONFIG_ZVFS_OPEN_MAX=30

# optimization level
# refer to Kconfig.zephyr for Optimizations Level
CONFIG_SPEED_OPTIMIZATIONS=y
#CONFIG_SIZE_OPTIMIZATIONS=y
#CONFIG_DEBUG_OPTIMIZATIONS=y
#CONFIG_NO_OPTIMIZATIONS=y

# comment out for -O0
# CONFIG_CODE_DATA_RELOCATION_SRAM=y
```

## src/main.cpp
```c
/*
 * Copyright (c) 2023, Meta
 *
 * SPDX-License-Identifier: Apache-2.0
 */

/*
 * Copyright (c) 2024 Muhammad Haziq
 *
 * SPDX-License-Identifier: Apache-2.0
 */


#include <stdio.h>
#include <zephyr/kernel.h>
#include <errno.h>

// Sensor fusion
#include "imu_orientation.h"
#include <cmath>
#include <iostream>
#include <unistd.h>

void benchmarkSensorFusion(int num_loops) {
  IMU_Orientation sensor_fusion;
  int count = num_loops;
  uint32_t start, end, elapsed_time;
  float time_per_loop;
  start = k_cycle_get_32();
  while (count--) {
      sensor_fusion.setAccelerometerValues(0, 1, 0);
      sensor_fusion.setGyroscopeRadianValues(0, 0, 0, 0.001);
      sensor_fusion.setMagnetometerValues(0, 1, 2);
      sensor_fusion.update();
  }
  end = k_cycle_get_32();
  elapsed_time = end-start;
  time_per_loop = float(elapsed_time) / float(num_loops);
  elapsed_time = k_cyc_to_ms_ceil32(elapsed_time);


  // Print time
  std::cout << "Iterations: " << num_loops << " total_time: " << elapsed_time << "ms"<< " unit_time: " << time_per_loop << "us"<< std::endl;
}

/********* MAIN **********/
int main(void)
{
    // Initialise devices
    std::cout << "Benchmark RW612 Sensor Fusion Performance " << std::endl;
    int trials = 5;
    int i = 0;

    while(trials--) {
        std::cout << "Start Test " << i << std::endl;
        i++;
        benchmarkSensorFusion(100000);
    }
}
```
